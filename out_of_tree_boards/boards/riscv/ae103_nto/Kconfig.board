## out_of_tree_boards/boards/riscv/ae103_nto/Kconfig.board
```kconfig
# Copyright (c) 2023, Intel Corporation
# SPDX-License-Identifier: Apache-2.0

config BOARD_SPK32_AE103_NTO
	bool "SPK32 AE103 NTO"
	depends on SOC_AE103_NTO
```

## out_of_tree_boards/boards/riscv/ae103_nto/Kconfig.defconfig
```kconfig
# Copyright (c) 2026 Sparkle Silicon Technology Corp., Ltd.
# SPDX-License-Identifier: Apache-2.0

if BOARD_SPK32_AE103_NTO

config BOARD
	default "ae103_nto"

endif # BOARD_SPK32_AE103_NTO
```

## out_of_tree_boards/boards/riscv/ae201/Kconfig.defconfig
```kconfig
# Copyright (c) 2026 Sparkle Silicon Technology Corp., Ltd.
# SPDX-License-Identifier: Apache-2.0

if BOARD_SPK32_AE201

config BOARD
	default "ae201"

endif # BOARD_SPK32_AE201
```

## out_of_tree_boards/boards/riscv/ae201_nto/Kconfig.board
```kconfig
# Copyright (c) 2023, Intel Corporation
# SPDX-License-Identifier: Apache-2.0

config BOARD_SPK32_AE201_NTO
	bool "SPK32 AE201 NTO"
	depends on SOC_AE201
```

## out_of_tree_boards/boards/riscv/ae201_nto/Kconfig.defconfig
```kconfig
# Copyright (c) 2026 Sparkle Silicon Technology Corp., Ltd.
# SPDX-License-Identifier: Apache-2.0

if BOARD_SPK32_AE201_NTO

config BOARD
	default "ae201_nto"

endif # BOARD_SPK32_AE201_NTO
```

## out_of_tree_boards/boards/riscv/spk32ae201/Kconfig.defconfig
```kconfig
# Copyright (c) 2026 Sparkle Silicon Technology Corp., Ltd.
# SPDX-License-Identifier: Apache-2.0

if BOARD_SPK32_AE201

config BOARD
	default "spk32ae201"

endif # BOARD_SPK32_AE201
```

## out_of_tree_boards/boards/riscv/spksilicon/ae201/Kconfig.board
```kconfig
# Copyright (c) 2023, Intel Corporation
# SPDX-License-Identifier: Apache-2.0

config BOARD_SPK32_AE201
	bool "SPK32 AE201"
	depends on SOC_AE201
```
